## main/audio/wake_words/micro_wake_word/models/Kconfig
```kconfig
choice
    prompt "模型"

config MICRO_WAKE_WORD_MODEL_ALEXA
    bool "Alexa"

config MICRO_WAKE_WORD_MODEL_HEY_JARVIS
    bool "Hey Jarvis"

config MICRO_WAKE_WORD_MODEL_HEY_MYCROFT
    bool "Hey Mycroft"

config MICRO_WAKE_WORD_MODEL_OKAY_NABU
    bool "Okay Nabu"

config MICRO_WAKE_WORD_MODEL_XIAOLINGXIAOLING
    bool "小聆小聆"

config MICRO_WAKE_WORD_MODEL_HI_LINA
    bool "Hi Lina"

endchoice
```
